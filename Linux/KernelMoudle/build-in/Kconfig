## Linux/KernelMoudle/build-in/Kconfig
```kconfig
# SPDX-License-Identifier: GPL-2.0-only

# menuconfig CONNECTOR
# 	tristate "Connector - unified userspace <-> kernelspace linker"
# 	depends on NET
# 	help
# 	  This is unified userspace <-> kernelspace connector working on top
# 	  of the netlink socket protocol.
#
# 	  Connector support can also be built as a module.  If so, the module
# 	  will be called cn.

# if CONNECTOR

config COLLIN_DEMO
	bool "collin demo driver"
	default y
	select WANT_DEV_COREDUMP
	help
	  my test demo

# endif # CONNECTOR
```
